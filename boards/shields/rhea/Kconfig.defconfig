## boards/shields/rhea/Kconfig.defconfig
```kconfig
if SHIELD_RHEA_R

config ZMK_KEYBOARD_NAME
    default "Rhea"

config ZMK_SPLIT
    default y

config ZMK_SPLIT_ROLE_CENTRAL
    default y

endif

if SHIELD_RHEA_L

config ZMK_KEYBOARD_NAME
    default "Rhea"

config ZMK_SPLIT
    default y

endif
```

## boards/shields/rhea/Kconfig.shield
```kconfig
config SHIELD_RHEA_R
    def_bool $(shields_list_contains,rhea_R)

config SHIELD_RHEA_L
    def_bool $(shields_list_contains,rhea_L)
```
